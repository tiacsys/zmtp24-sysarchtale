## source/samples/dts/bindings/gpio/acme,prph_if.yaml
```yaml
description: |
    GPIO pins exposed as ACME Peripheral Board connector.

    This binding provides a nexus mapping for 24 pins where parent pin 11
    correspond to analog input line, all other parent pins 0 through 10 and
    pins 12 through 24 correspond to digital in-/out lines, as depicted below:

               0 GPIO
               1 MOTOR_SPI_nCS
               - GND
               2 GPIO
               3 GPIO
               4 GPIO
               - GND
               5 MOTOR_POS1
               6 MOTOR_POS2
               7 MOTOR_STEP
               8 MOTOR_DIR
               - GND
               9 PP_I2C_SCL
              10 PP_I2C_SDA
               - GND
              11 HEATER_THERM_ADCIN
               - GND
              12 PP_SPI_MISO
              13 PP_SPI_MOSI
              14 PP_SPI_CLK
               - GND
              15 HEATER_PWM
               - GND
              16 AFE_SPI_nCS1
              17 AFE_SPI_nCS2
              18 AFE_SPI_nCS3
              19 AFE_SPI_nCS4
              20 AFE_INT1
              21 AFE_INT2
              22 AFE_INT3
              23 AFE_INT4
              24 AFE_nRESET

compatible: "acme,prph_if"

include: [gpio-nexus.yaml, base.yaml]
```

## source/samples/subsys/Kconfig
```kconfig
menu "ACME Subsystems"

 menu "Modules"
  rsource "m_heater/Kconfig"
  rsource "m_motor/Kconfig"
  rsource "m_afe/Kconfig"
 endmenu #Modules

 menu "Core Services"
  rsource "s_mqtt_rpc"
  rsource "s_datascope"
 endmenu #Core Services
endmenu #ACME Subsystems
```

## source/samples/subsys/Kconfig.template.subsystem
```kconfig
if SUBSYS_$(subsys)
    config ACME_SUBSYS_$(subsys)_PRIORITY_INDEX
        int "Priority index for startup"
        default 42

    config ACME_SUBSYS_$(subsys)_THREAD_STACK_SIZE
        int "Stack size of subsystem thread"
        default 2048

    config ACME_SUBSYS_$(subsys)_MQTT_RPC
        bool "Enable MQTT-RPC bindings for $(subsys-str) subsystem"
        depends on ACME_MQTT_RPC

    config ACME_SUBSYS_$(subsys)_SHELL
        bool "Enable shell bindings for $(subsys-str) subsystem"
        depends on SHELL

    config ACME_SUBSYS_$(subsys)_SCOPE
        bool "Enable data scope bindings for $(subsys-str) subsystem"
        depends on ACME_SCOPE

    # add a log level option using zephyr's template
    module = ACME_SUBSYS_$(subsys)
    module-str = $(subsys-str) subsystem
    source "subsys/logging/Kconfig.template.log_config"
endif
```

## source/samples/subsys/m_afe/Kconfig
```kconfig
menuconfig ACME_SUBSYS_AFE # option to toggle the entire subsystem on/off
    bool "Analog Front End subsystem"
    help
        The AFE subsystem is responsible for measuring the probe signals.

subsys = AFE
subsys-str = afe
rsource "../Kconfig.tmpl.m_subsystem"
```

## source/samples/subsys/m_heater/Kconfig
```kconfig
menuconfig ACME_SUBSYS_HEATER # option to toggle the entire subsystem on/off
    bool "Heater subsystem"
    help
        The Heater subsystem is responsible for measuring and controlling
        the temperature.

subsys = HEATER
subsys-str = heater
rsource "../Kconfig.tmpl.m_subsystem"
```
